## Kconfig
```kconfig
# SPDX-License-Identifier: GPL-2.0-only
#
# Google Wonder WiFi Virtual Device Driver
#

config ANDROID_WONDER
	tristate "Wonder WiFi virtual device driver"
	depends on MAC80211
	depends on AUXILIARY_BUS
	help
	  This enables the Google Wonder WiFi virtual device driver. This
	  driver acts as a middleware layer using the mac80211 framework
	  to provide a vendor-agnostic interface to userspace.

	  To build this as a module, choose m.

config ANDROID_WONDER_SYNA_SUPPORT
	bool "Wonder Synaptics Support"
	help
	  This enables Synaptics-specific support for the Wonder virtual
	  device driver, including specialized RX handling and frame
	  adjustments for Synaptics hardware.

config ANDROID_WONDER_TX_DEBUG
	bool "Wonder TX Debug Message Support"
	help
	  This enables detailed debug messages for the transmit path in the
	  Wonder driver, including packet hex dumps and flow tracing.

config ANDROID_WONDER_RX_DEBUG
	bool "Wonder RX Debug Message Support"
	help
	  This enables detailed debug messages for the receive path in the
	  Wonder driver, including packet hex dumps and filtering results.

config ANDROID_WONDER_RX_FILTER_SUPPORT
	bool "Wonder RX Filter Support"
	help
	  This enables support for hardware-accelerated RX filtering in the
	  Wonder driver, allowing the device to drop unwanted frames before
	  they reach the host networking stack.
```
